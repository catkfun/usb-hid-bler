## sdkconfig.defaults.esp32c3
```kconfig
CONFIG_BT_ENABLED=y
CONFIG_BT_BLUEDROID_ENABLED=y
CONFIG_BT_BLE_ENABLED=y
CONFIG_BT_BLE_42_FEATURES_SUPPORTED=y
CONFIG_SOC_SPI_MEM_SUPPORT_AUTO_SUSPEND=n
CONFIG_SOC_SPI_MEM_SUPPORT_AUTO_RESUME=n
```
